## package/gconf/Config.in
```kconfig
config BR2_PACKAGE_GCONF
	bool "gconf"
	select BR2_PACKAGE_DBUS_GLIB
	select BR2_PACKAGE_LIBXML2
	help
	  The GConf package contains a configuration database system used by many GNOME
	  applications.

	  http://ftp.gnome.org/pub/gnome/sources/GConf/3.2
```

## package/unclutter/Config.in
```kconfig
config BR2_PACKAGE_UNCLUTTER
	bool "unclutter"
    depends on BR2_PACKAGE_XLIB_LIBX11
	help
      Unclutter runs in the background of an X11 session and after a specified period of inactivity hides the cursor from display. 
      When the cursor is moved its display is restored. 
      Users may specify specific windows to be ignored by unclutter.

	  https://sourceforge.net/projects/unclutter/
```
